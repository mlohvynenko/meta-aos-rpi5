## meta-aos-rpi5-domd/conf/layer.conf
```bitbake
# We have a conf and classes directory, append to BBPATH
BBPATH .= ":${LAYERDIR}"

# We have a recipes directory containing .bb and .bbappend files, add to BBFILES
BBFILES += "${LAYERDIR}/recipes*/*/*.bb \
            ${LAYERDIR}/recipes*/*/*.bbappend"

BBFILE_COLLECTIONS += "aos-rpi5-domd"
BBFILE_PATTERN_aos-rpi5-domd := "^${LAYERDIR}/"
BBFILE_PRIORITY_aos-rpi5-domd = "14"

LAYERSERIES_COMPAT_aos-rpi5-domd = "scarthgap"
LAYERDEPENDS_aos-rpi5-domd = "core xt-security xt-rpi5"
```
